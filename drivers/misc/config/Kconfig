## drivers/misc/config/Kconfig
```kconfig
config FORCE_FAST_CHARGE
	bool "Force AC charge mode at will"
	default y
	help
	  A simple sysfs interface to force adapters that
	  are detected as USB to charge as AC.
```
